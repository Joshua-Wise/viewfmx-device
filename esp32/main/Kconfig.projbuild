## esp32/main/Kconfig.projbuild
```kconfig
menu "viewFMX Device"

    config VIEWFMX_USE_MOCK
        bool "Use mock data provider (offline, no network)"
        default y
        help
            When enabled the device shows canned room data and never
            touches the network. Disable once Wi-Fi + the HTTP provider
            are implemented (phase 2).

    config VIEWFMX_BASE_URL
        string "viewfmx server base URL"
        default "https://viewfmx.celinaisd.com"

    config VIEWFMX_RESOURCE_ID
        string "Room resource ID"
        default "0"

    config VIEWFMX_BUILDING_ID
        string "Building ID"
        default "0"

    config VIEWFMX_TZ
        string "POSIX timezone for displayed times"
        default "CST6CDT,M3.2.0,M11.1.0"
        help
            Meeting times arrive as UTC and are rendered in this zone.
            Default is US Central (Celina ISD).

    config VIEWFMX_MOTION_DIM
        bool "Dim display when no motion (bezel camera)"
        default y
        help
            Uses the MIPI-CSI camera for presence detection and fades the
            backlight after a period without motion or touch.

    config VIEWFMX_DIM_TIMEOUT_S
        int "Seconds of no motion/touch before dimming"
        depends on VIEWFMX_MOTION_DIM
        default 600

    config VIEWFMX_DIM_LEVEL
        int "Dimmed brightness (percent)"
        depends on VIEWFMX_MOTION_DIM
        range 1 100
        default 15

endmenu
```

## esp32/sdkconfig.defaults
```kconfig
# Guition JC1060P470C — ESP32-P4, 16MB flash, 32MB hex PSRAM
CONFIG_IDF_TARGET="esp32p4"

CONFIG_ESPTOOLPY_FLASHSIZE_16MB=y
CONFIG_PARTITION_TABLE_CUSTOM=y
CONFIG_PARTITION_TABLE_CUSTOM_FILENAME="partitions.csv"

CONFIG_SPIRAM=y
CONFIG_SPIRAM_MODE_HEX=y
CONFIG_SPIRAM_SPEED_200M=y
CONFIG_SPIRAM_XIP_FROM_PSRAM=y
CONFIG_CACHE_L2_CACHE_256KB=y
CONFIG_CACHE_L2_CACHE_LINE_128B=y

CONFIG_COMPILER_OPTIMIZATION_PERF=y
CONFIG_FREERTOS_HZ=1000

# HTTP fetches run in the main task (initial load) — default 3.5K overflows
CONFIG_ESP_MAIN_TASK_STACK_SIZE=10240

# LVGL v9 (configured via Kconfig, not lv_conf.h)
CONFIG_LV_COLOR_DEPTH_16=y
CONFIG_LV_FONT_MONTSERRAT_14=y
CONFIG_LV_FONT_MONTSERRAT_16=y
CONFIG_LV_FONT_MONTSERRAT_20=y
CONFIG_LV_FONT_MONTSERRAT_24=y
CONFIG_LV_FONT_MONTSERRAT_32=y
CONFIG_LV_FONT_MONTSERRAT_40=y

# Bezel camera (MIPI-CSI) for motion dimming; sensor auto-detected on SCCB
CONFIG_ESP_VIDEO_ENABLE_MIPI_CSI_VIDEO_DEVICE=y
CONFIG_CAMERA_SC2336=y
CONFIG_CAMERA_SC2336_AUTO_DETECT_MIPI_INTERFACE_SENSOR=y
CONFIG_CAMERA_OV02C10=y
CONFIG_CAMERA_OV02C10_AUTO_DETECT=y
CONFIG_CAMERA_OV02C10_AUTO_DETECT_MIPI_INTERFACE_SENSOR=y
CONFIG_CAMERA_XCLK_USE_ESP_CLOCK_ROUTER=y

# UI-task watchdog: a stalled LVGL task reboots the sign instead of freezing
CONFIG_ESP_TASK_WDT_TIMEOUT_S=30
CONFIG_ESP_TASK_WDT_PANIC=y
```
